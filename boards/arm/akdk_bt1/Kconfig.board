## boards/arm/akdk_bt1/Kconfig.board
```kconfig
# SPDX-License-Identifier: MIT

config BOARD_AKDK_BT1
	bool "akdk_bt1"
	depends on SOC_NRF52840_QIAA
	imply RETAINED_MEM
	imply RETENTION
	imply RETENTION_BOOT_MODE
```

## boards/arm/akdk_bt1/Kconfig.defconfig
```kconfig
if BOARD_AKDK_BT1

choice ZMK_BOOTMODE_MAGIC_VALUE_BOOTLOADER_TYPE
	default ZMK_BOOTMODE_MAGIC_VALUE_BOOTLOADER_TYPE_ADAFRUIT_NRF52
endchoice

if USB_DEVICE_STACK

config USB_NRFX
    default y

endif # USB_DEVICE_STACK

config BT_CTLR
    default BT

endif
```

## boards/shields/split_ergo60pct/Kconfig.defconfig
```kconfig
if SHIELD_DONGLE

rsource "dongle_screen/Kconfig.defconfig"

# Max 16 characters in keyboard name
config ZMK_KEYBOARD_NAME
    default "My zmk dongle"
config BT_DEVICE_NAME
    default "My ZMK dongle"

config ZMK_SPLIT_ROLE_CENTRAL
    default y
config ZMK_SPLIT
    default y
# ドングルが管理するペリフェラル数（例：左右分割なら2）
config ZMK_SPLIT_BLE_CENTRAL_PERIPHERALS
    default 2
# BTプロファイル数（デフォルト5）＋ペリフェラル数
config BT_MAX_CONN
    default 7
config BT_MAX_PAIRED
    default 9
endif

if SHIELD_SPLIT_ERGO60PCT_LEFT

config ZMK_KEYBOARD_NAME
    default "split_ergo60pct"

endif

if SHIELD_SPLIT_ERGO60PCT_LEFT || SHIELD_SPLIT_ERGO60PCT_RIGHT

config ZMK_SPLIT
    default y

endif
```

## boards/shields/split_ergo60pct/Kconfig.shield
```kconfig
# No whitespace after the comma or in the keyboard name!
config SHIELD_DONGLE
    def_bool $(shields_list_contains,dongle)

config SHIELD_SPLIT_ERGO60PCT_LEFT
    def_bool $(shields_list_contains,split_ergo60pct_left)

config SHIELD_SPLIT_ERGO60PCT_RIGHT
    def_bool $(shields_list_contains,split_ergo60pct_right)

# --- ここから下はドングル (dongle) ビルドの時だけ有効になる ---
if SHIELD_DONGLE

config DONGLE_SCREEN_WPM_ACTIVE
    bool "Enable WPM widget"

config DONGLE_SCREEN_LAYER_ACTIVE
    bool "Enable layer widget"

config DONGLE_SCREEN_MODIFIER_ACTIVE
    bool "Enable modifier widget"

config DONGLE_SCREEN_OUTPUT_ACTIVE
    bool "Enable output widget"

config DONGLE_SCREEN_BATTERY_ACTIVE
    bool "Enable battery widget"

endif # SHIELD_DONGLE
```

## config/west.yml
```yaml
# sekigon-gonnoc版（使う場合はコメントアウトを外す）
manifest:
  remotes:
    - name: zmkfirmware
      url-base: https://github.com/zmkfirmware
    - name: sekigon-gonnoc
      url-base: https://github.com/sekigon-gonnoc
    - name: caksoylar
      url-base: https://github.com/caksoylar
    - name: inorichi
      url-base: https://github.com/inorichi
    - name: carrefinho                        
      url-base: https://github.com/carrefinho
    - name: janpfischer
      url-base: https://github.com/janpfischer
    - name: kot149
      url-base: https://github.com/kot149
    - name: halfdane
      url-base: https://github.com/halfdane

  projects:
    - name: zmk
      remote: zmkfirmware
      revision: v0.3
      import: app/west.yml
    - name: zmk-driver-paw3222
      remote: sekigon-gonnoc
      revision: main
    - name: zmk-rgbled-widget
      remote: caksoylar
      revision: main
    - name: zmk-pmw3610-driver
      remote: inorichi
      revision: main
    - name: prospector-zmk-module                 # <--- and these
      remote: carrefinho                          # <---
      revision: main  
    - name: zmk-dongle-screen
      remote: janpfischer
      revision: main
    - name: zmk-mouse-gesture
      remote: kot149
      revision: v1
    - name: zmk-input-processors
      remote: halfdane
      revision: main
      path: modules/zmk-input-processors 
    - name: zmk-input-gestures
      remote: halfdane
      revision: main
      path: modules/zmk-input-gestures
  
  self:
    path: config
```
